## arch/arm/core/arm9/Kconfig
```kconfig
config CPU_ARM920T
	bool
	select CPU_ARM9
	# Omit prompt to signify "hidden" option
	select ARMV4T
	help
	  This option signifies the use of a arm9 CPU
	  
if CPU_ARM9
 
config ARMV4T
	bool
	# Omit prompt to signify "hidden" option
	help
	  This option signifies the use of an ARMv4t processor
	  implementation.
	  
endif
```

## boards/arm/jz2440/jz2440_defconfig
```kconfig
# SPDX-License-Identifier: Apache-2.0

CONFIG_ARM=y
CONFIG_SOC_FAMILY_S3C24XX=y
CONFIG_SOC_SERIES_S3C2440=y

CONFIG_FLASH_SIZE=1024
CONFIG_FLASH_BASE_ADDRESS=0x30000000
CONFIG_SRAM_SIZE=1024
CONFIG_SRAM_BASE_ADDRESS=0x30000000
#CONFIG_XIP=y
CONFIG_HAS_FLASH_LOAD_OFFSET=y
CONFIG_FLASH_LOAD_OFFSET=0x00000000

CONFIG_MULTITHREADING=y
CONFIG_S3C2440_TIMER=y

CONFIG_TICKLESS_CAPABLE=n
CONFIG_SYS_CLOCK_TICKS_PER_SEC=100

CONFIG_ARCH_HAS_CUSTOM_SWAP_TO_MAIN=y

CONFIG_GEN_ISR_TABLES=y
CONFIG_GEN_SW_ISR_TABLE=y
CONFIG_GEN_IRQ_VECTOR_TABLE=n

# enable gpio group F
CONFIG_GPIO_S3C24XX_PF=y

CONFIG_FORCE_NO_ASSERT=y

# enable uart driver
CONFIG_SERIAL=y
CONFIG_UART_S3C2440=y
CONFIG_UART_0_S3C2440_UART=y

# enable console
CONFIG_CONSOLE=y
CONFIG_UART_CONSOLE=y
CONFIG_UART_CONSOLE_ON_DEV_NAME="uart_s3c2440_drv"

# heap size 64*1024
CONFIG_HEAP_MEM_POOL_SIZE=65536
```

## drivers/gpio/Kconfig.s3c24xx
```kconfig
# Copyright (c) 2018 Nordic Semiconductor ASA
#
# SPDX-License-Identifier: Apache-2.0
#

menuconfig GPIO_S3C24XX
	bool "S3C24XX GPIO driver"
	default y
	depends on SOC_FAMILY_S3C24XX
	select HAS_DTS_GPIO
	help
	  Enable GPIO driver for S3C24XX line of MCUs.

if GPIO_S3C24XX

config GPIO_S3C24XX_INIT_PRIORITY
	int "S3C24XX GPIO initialization priority"
	default 40
	help
	  Initialization priority for S3C24XX GPIO.

config GPIO_S3C24XX_PB
	bool "S3C24XX GPIO Port PB"
	depends on HAS_HW_S3C24XX_GPIOB
	default y
	help
	  Enable S3C24XX GPIO port PB config options.

config GPIO_S3C24XX_PE
	bool "S3C24XX GPIO Port PE"
	depends on HAS_HW_S3C24XX_GPIOE
	default y
	help
	  Enable S3C24XX GPIO port PE config options.

config GPIO_S3C24XX_PF
	bool "S3C24XX GPIO Port PF"
	depends on HAS_HW_S3C24XX_GPIOF
	default y
	help
	  Enable S3C24XX GPIO port PF config options.

endif # GPIO_S3C24XX
```

## drivers/serial/Kconfig.s3c2440
```kconfig
menuconfig UART_S3C2440
    bool "S3C2440 MCU serial driver"
	select SERIAL_HAS_DRIVER
	depends on SOC_SERIES_S3C2440
	help
	  This option enables the UART driver for S3C2440 family of
	  processors.

config UART_0_S3C2440_UART
	bool "S3C2440 UART 0"
    depends on UART_S3C2440
	help
	    Enable S3C2440 UART.
```

## dts/bindings/gpio/samsung,s3c24xx-gpio.yaml
```yaml
#
# Copyright (c) 2018, marc-cpdesign
#
# SPDX-License-Identifier: Apache-2.0
#
---
title: S3C24XX GPIO
version: 0.1

description: >
    This is a representation of the S3C24XX GPIO nodes

properties:
    compatible:
      type: string
      category: required
      description: compatible strings
      constraint: "samsung,s3c24xx-gpio"
      generation: define

    reg:
      type: int
      description: mmio register space
      generation: define
      category: required

    label:
      type: string
      category: required
      description: Human readable string describing the device (used by Zephyr for API name)
      generation: define

cell_string: GPIO

"#cells":
  - pin
  - flags
...
```

## soc/arm/samsung_24xx/Kconfig
```kconfig
#
# Copyright (c) 2017, NXP
#
# SPDX-License-Identifier: Apache-2.0
#

config SOC_FAMILY_S3C24XX
	bool
	# omit prompt to signify a "hidden" option

if SOC_FAMILY_S3C24XX

config SOC_FAMILY
	string
	default "samsung_24xx"
	
source "soc/arm/samsung_24xx/*/Kconfig.soc"	
source "soc/arm/samsung_24xx/Kconfig.peripherals"

endif # SOC_FAMILY_S3C24XX
```

## soc/arm/samsung_24xx/Kconfig.peripherals
```kconfig
config HAS_HW_S3C24XX_ADC
	bool

config HAS_HW_S3C24XX_GPIOF
	bool

config HAS_HW_S3C24XX_I2S
	bool
	
config HAS_HW_S3C24XX_SPI0
	bool

config HAS_HW_S3C24XX_TIMER0
	bool


config HAS_HW_S3C24XX_UART0
	bool
```

## soc/arm/samsung_24xx/Kconfig.soc
```kconfig
#
# Copyright (c) 2018, Cypress
#
# SPDX-License-Identifier: Apache-2.0
#

source "soc/arm/samsung_24xx/*/Kconfig.series"
```

## soc/arm/samsung_24xx/s3c2440/Kconfig.defconfig.series
```kconfig
# Kconfig.defconfig.series - Cypress Semiconductor PSoC6 series configuration
# options
#
# Copyright (c) 2018, Cypress
#
# SPDX-License-Identifier: Apache-2.0
#

if SOC_SERIES_S3C2440

config SOC_SERIES
	default "s3c2440"

config SYS_CLOCK_HW_CYCLES_PER_SEC
	int
	default 50000000

config NUM_IRQS
	int
	default 32

endif # SOC_SERIES_S3C2440
```

## soc/arm/samsung_24xx/s3c2440/Kconfig.series
```kconfig
# Kconfig.series - Cypress PSoC6 MCU line
#
# Copyright (c) 2018, Cypress Semiconductor
#
# SPDX-License-Identifier: Apache-2.0
#

config SOC_SERIES_S3C2440
	bool "SAMSUNG S3C2440 series SOC"
	select SOC_FAMILY_S3C24XX
	select CPU_ARM920T
	select HAS_HW_S3C24XX_GPIOF
	help
	  Enable support for Samsung s3c2440 soc series
```
